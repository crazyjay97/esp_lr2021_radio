#include "epd_gysd154.h"
#include "bsp.h"
#include "board_config.h"

#include <string.h>
#include "freertos/FreeRTOS.h"
#include "freertos/task.h"
#include "driver/gpio.h"
#include "driver/spi_master.h"
#include "esp_check.h"
#include "esp_log.h"

#define TAG "epd"

/* EPD commands (UC8151C / IL0373) */
#define CMD_PSR    0x00
#define CMD_PWR    0x01
#define CMD_PON    0x04
#define CMD_BTST   0x06
#define CMD_DSLP   0x07
#define CMD_DTM1   0x10  /* BW plane */
#define CMD_DSP    0x11
#define CMD_DRF    0x12  /* Full refresh */
#define CMD_DTM2   0x13  /* RY plane */
#define CMD_LUTOPT 0x2A
#define CMD_PLL    0x30
#define CMD_CDI    0x50
#define CMD_TRES   0x61
#define CMD_REV    0x70
#define CMD_FLG    0x71
#define CMD_AMV    0x80
#define CMD_VV     0x81
#define CMD_VDCS   0x82

#define EPD_BUSY_GPIO  GPIO_NUM_4
#define EPD_DC_GPIO    BSP_LCD_SPI_DC_GPIO   /* GPIO48 */
#define EPD_CS_GPIO    BSP_LCD_SPI_CS_GPIO   /* GPIO47 */

/* Two 200x200 bit planes: BW and RY, each 5000 bytes */
#define PLANE_BYTES ((EPD_WIDTH * EPD_HEIGHT) / 8)

static spi_device_handle_t s_spi;
static uint8_t s_bw[PLANE_BYTES];
static uint8_t s_ry[PLANE_BYTES];

/* ---- minimal 8x8 ASCII font (32..126), stored MSB-first per row -------- */
/* Using the classic 8x8 bitmap font; only printable ASCII subset included. */
static const uint8_t s_font8x8[][8] = {
    {0x00,0x00,0x00,0x00,0x00,0x00,0x00,0x00}, /* 32 ' ' */
    {0x18,0x3C,0x3C,0x18,0x18,0x00,0x18,0x00}, /* 33 '!' */
    {0x36,0x36,0x00,0x00,0x00,0x00,0x00,0x00}, /* 34 '"' */
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    {0x6E,0x3B,0x00,0x00,0x00,0x00,0x00,0x00}, /* 126 '~' */
};

/* ---- low-level SPI helpers ----------------------------------------------- */

static void epd_wait_busy(void)
{
    /* BUSY is active HIGH on UC8151C: wait for it to go low */
    while (gpio_get_level(EPD_BUSY_GPIO) == 1) {
        vTaskDelay(pdMS_TO_TICKS(10));
    }
}

static esp_err_t epd_send(uint8_t dc_level, const uint8_t *data, size_t len)
{
    gpio_set_level(EPD_DC_GPIO, dc_level);
    spi_transaction_t t = {
        .length = len * 8,
        .tx_buffer = data,
    };
    return spi_device_polling_transmit(s_spi, &t);
}

static esp_err_t epd_cmd(uint8_t cmd)
{
    return epd_send(0, &cmd, 1);
}

static esp_err_t epd_data(const uint8_t *buf, size_t len)
{
    return epd_send(1, buf, len);
}

static esp_err_t epd_data1(uint8_t b)
{
    return epd_data(&b, 1);
}

/* ---- hardware init ------------------------------------------------------- */

static esp_err_t epd_hw_init(void)
{
    /* Power-on sequence for UC8151C / IL0373 4-colour (BW+RY) */
    uint8_t tmp[5];

    /* Panel Setting */
    epd_cmd(CMD_PSR);
    epd_data1(0xCF);  /* LUT from OTP, 200x200, KW/R mode, scan down, shift right */
    epd_data1(0x08);

    /* Power Setting */
    epd_cmd(CMD_PWR);
    tmp[0]=0x37; tmp[1]=0x00; tmp[2]=0x05; tmp[3]=0x05;
    epd_data(tmp, 4);

    /* Booster Soft-Start */
    epd_cmd(CMD_BTST);
    tmp[0]=0xC7; tmp[1]=0xCC; tmp[2]=0x28;
    epd_data(tmp, 3);

    /* Power On */
    epd_cmd(CMD_PON);
    epd_wait_busy();

    /* PLL Control: 50 Hz */
    epd_cmd(CMD_PLL);
    epd_data1(0x3C);

    /* Resolution: 200x200 */
    epd_cmd(CMD_TRES);
    tmp[0]=0x00; tmp[1]=0xC8; tmp[2]=0x00; tmp[3]=0xC8;
    epd_data(tmp, 4);

    /* VCOM and Data Interval: border white, CDI=0x77 */
    epd_cmd(CMD_CDI);
    epd_data1(0x77);

    return ESP_OK;
}

/* ---- pixel helpers ------------------------------------------------------- */

static void set_pixel(int x, int y, epd_color_t c)
{
    if (x < 0 || x >= EPD_WIDTH || y < 0 || y >= EPD_HEIGHT) return;
    int idx = (y * EPD_WIDTH + x) / 8;
    int bit = 7 - ((y * EPD_WIDTH + x) % 8);
    /* BW plane: white=1, others=0 */
    if (c == EPD_WHITE)      s_bw[idx] |=  (1 << bit);
    else                     s_bw[idx] &= ~(1 << bit);
    /* RY plane: red or yellow=1, others=0 */
    if (c == EPD_RED || c == EPD_YELLOW) s_ry[idx] |=  (1 << bit);
    else                                  s_ry[idx] &= ~(1 << bit);
}

/* ---- public API ---------------------------------------------------------- */

esp_err_t epd_init(void)
{
    /* BUSY pin */
    gpio_config_t io = {
        .pin_bit_mask = (1ULL << EPD_BUSY_GPIO),
        .mode = GPIO_MODE_INPUT,
        .pull_up_en = GPIO_PULLUP_ENABLE,
    };
    ESP_RETURN_ON_ERROR(gpio_config(&io), TAG, "busy gpio");

    /* DC and CS as outputs (CS managed by SPI driver) */
    gpio_set_direction(EPD_DC_GPIO, GPIO_MODE_OUTPUT);

    /* Initialize SPI3 bus if not already done (shares pins with LCD) */
    spi_bus_config_t bus_cfg = {
        .mosi_io_num = BSP_LCD_SPI_MOSI_GPIO,
        .miso_io_num = -1,
        .sclk_io_num = BSP_LCD_SPI_SCLK_GPIO,
        .quadwp_io_num = -1,
        .quadhd_io_num = -1,
        .max_transfer_sz = 64 * 1024,
    };
    esp_err_t bus_ret = spi_bus_initialize(SPI3_HOST, &bus_cfg, SPI_DMA_CH_AUTO);
    if (bus_ret != ESP_OK && bus_ret != ESP_ERR_INVALID_STATE) {
        ESP_LOGE(TAG, "spi_bus_initialize: %s", esp_err_to_name(bus_ret));
        return bus_ret;
    }

    /* Add EPD device to SPI bus */
    spi_device_interface_config_t dev = {
        .clock_speed_hz = 4 * 1000 * 1000,
        .mode = 0,
        .spics_io_num = EPD_CS_GPIO,
        .queue_size = 4,
    };
    ESP_RETURN_ON_ERROR(spi_bus_add_device(SPI3_HOST, &dev, &s_spi), TAG, "spi dev");

    /* RST: pulse low via IO expander P3 */
    bsp_ioexp_set_pin(BSP_IO_EXP_LCD_RST_PIN, false);
    vTaskDelay(pdMS_TO_TICKS(10));
    bsp_ioexp_set_pin(BSP_IO_EXP_LCD_RST_PIN, true);
    vTaskDelay(pdMS_TO_TICKS(100));

    /* Fill planes with white */
    memset(s_bw, 0xFF, PLANE_BYTES);
    memset(s_ry, 0x00, PLANE_BYTES);

    return epd_hw_init();
}

esp_err_t epd_clear(epd_color_t bg)
{
    uint8_t bw_fill = (bg == EPD_WHITE || bg == EPD_YELLOW) ? 0xFF : 0x00;
    uint8_t ry_fill = (bg == EPD_RED   || bg == EPD_YELLOW) ? 0xFF : 0x00;
    memset(s_bw, bw_fill, PLANE_BYTES);
    memset(s_ry, ry_fill, PLANE_BYTES);
    return ESP_OK;
}

esp_err_t epd_print_text(int x, int y, const char *text,
                         epd_color_t fg, epd_color_t bg)
{
    for (; *text; text++, x += 8) {
        uint8_t c = (uint8_t)*text;
        if (c < 32 || c > 126) c = 32;
        const uint8_t *glyph = s_font8x8[c - 32];
        for (int row = 0; row < 8; row++) {
            for (int col = 0; col < 8; col++) {
                bool on = (glyph[row] >> (7 - col)) & 1;
                set_pixel(x + col, y + row, on ? fg : bg);
            }
        }
    }
    return ESP_OK;
}

esp_err_t epd_refresh(void)
{
    /* Write BW plane */
    epd_cmd(CMD_DTM1);
    epd_data(s_bw, PLANE_BYTES);
    epd_cmd(CMD_DSP);

    /* Write RY plane */
    epd_cmd(CMD_DTM2);
    epd_data(s_ry, PLANE_BYTES);
    epd_cmd(CMD_DSP);

    /* Trigger full refresh */
    epd_cmd(CMD_DRF);
    epd_wait_busy();

    return ESP_OK;
}

esp_err_t epd_sleep(void)
{
    epd_cmd(CMD_DSLP);
    epd_data1(0xA5);
    return ESP_OK;
}
